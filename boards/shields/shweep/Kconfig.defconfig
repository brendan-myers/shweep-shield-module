## boards/shields/shweep/Kconfig.defconfig
```kconfig
if SHIELD_SHWEEP_LEFT

config ZMK_KEYBOARD_NAME
    default "Shweep"

config ZMK_SPLIT_ROLE_CENTRAL
    default y

endif

if SHIELD_SHWEEP_LEFT || SHIELD_SHWEEP_RIGHT

config ZMK_SPLIT
    default y

endif
```

## boards/shields/shweep/Kconfig.shield
```kconfig
config SHIELD_SHWEEP_LEFT
    def_bool $(shields_list_contains,shweep_left)

config SHIELD_SHWEEP_RIGHT
    def_bool $(shields_list_contains,shweep_right)
```
